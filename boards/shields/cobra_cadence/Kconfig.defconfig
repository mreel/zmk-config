## boards/shields/cobra_cadence/Kconfig.defconfig
```kconfig
# Copyright (c) 2025 Tibo Loete
# SPDX-License-Identifier: MIT

if SHIELD_COBRA_CADENCE_RIGHT

config ZMK_KEYBOARD_NAME
    default "Cobra Cadence"

config ZMK_SPLIT_ROLE_CENTRAL
    default y

endif

if SHIELD_COBRA_CADENCE_LEFT

config ZMK_SPLIT_ROLE_CENTRAL
    default n

endif

if SHIELD_COBRA_CADENCE_LEFT || SHIELD_COBRA_CADENCE_RIGHT

config ZMK_SPLIT
    default y

endif

CONFIG_ZMK_KSCAN_DEBOUNCE_PRESS_MS=500
CONFIG_ZMK_KSCAN_DEBOUNCE_RELEASE_MS=500
```

## boards/shields/cobra_cadence/Kconfig.shield
```kconfig
# Copyright (c) 2025 Tibo Loete
# SPDX-License-Identifier: MIT

config SHIELD_COBRA_CADENCE_LEFT
    def_bool $(shields_list_contains,cobra_cadence_left)

config SHIELD_COBRA_CADENCE_RIGHT
    def_bool $(shields_list_contains,cobra_cadence_right)
```

## config/west.yml
```yaml
manifest:
  defaults:
    revision: v0.2
  remotes:
    - name: zmkfirmware
      url-base: https://github.com/zmkfirmware
    - name: mreel
      url-base: https://github.com/mreel
  projects:
    - name: zmk
      remote: zmkfirmware
      import: app/west.yml
    - name: cobra_cadence_module
      remote: mreel
      revision: main
  self:
    path: config
```
